## meta-cross/conf/layer.conf
```bitbake
BBPATH .= ":${LAYERDIR}"

BBFILES += "\
    ${LAYERDIR}/recipes-*/*/*.bb \
    ${LAYERDIR}/recipes-*/*/*.bbappend \
    ${LAYERDIR}/recipes-*/*/*/*.bb \
    ${LAYERDIR}/recipes-*/*/*/*.bbappend \
"

BBFILE_COLLECTIONS += "cross"
BBFILE_PATTERN_cross = "^${LAYERDIR}/"
BBFILE_PRIORITY_cross = "6"

LAYERSERIES_COMPAT_cross = "scarthgap"
```
